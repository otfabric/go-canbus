AUTOSAR XML (schema 4-3-0)
package /Net
  can cluster Bus: baudrate=500000
    can physical channel Ch
      frame Engine: id 0x100, frame-length=8, can-addressing-mode=STANDARD
        pdu EnginePdu: length=8
          signal Speed: start 0, 16 bit, little-endian, system signal SpeedSys, compu {phys=raw*0.125-40}
          signal Temp: start 20, 12 bit, big-endian, system signal TempSys
