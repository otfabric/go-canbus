AUTOSAR XML (schema 4-3-0)
# SPDX-License-Identifier: MIT
# canbus-interop fixture: MULTIPLEXED-I-PDUs: a 4-bit Intel selector with a static part and three alternatives, an 8-bit Motorola selector with two alternatives; every alternative maps the selector field too
standard types defined: sint8, sint16, sint32
package /Cluster
  can cluster Mux: baudrate=500000
    can physical channel Channel
      frame MuxFrame: id 0x310, frame-length=8, can-addressing-mode=STANDARD
        multiplexed i pdu MuxPdu: length=8, dynamic-part=dynamic-part-alternatives=[{i-pdu=Alt0Pdu, initial-dynamic-part=true, selector-field-code=0}, {i-pdu=Alt1Pdu, initial-dynamic-part=false, selector-field-code=1}, {i-pdu=Alt2Pdu, initial-dynamic-part=false, selector-field-code=2}], selector-field-byte-order=little-endian, selector-field-length=4, selector-field-start-position=0, static-part=StaticPdu, unused-bit-pattern=0
      frame BeMuxFrame: id 0x311, frame-length=8, can-addressing-mode=STANDARD
        multiplexed i pdu BeMuxPdu: length=8, dynamic-part=dynamic-part-alternatives=[{i-pdu=Alt5Pdu, initial-dynamic-part=false, selector-field-code=5}, {i-pdu=Alt10Pdu, initial-dynamic-part=true, selector-field-code=10}], selector-field-byte-order=big-endian, selector-field-length=8, selector-field-start-position=7, unused-bit-pattern=0
package /Pdus
  pdu StaticPdu: length=8
    signal Counter: start 56, 8 bit, little-endian, transfer-property=PENDING
  pdu Alt0Pdu: length=8
    signal Sel: start 0, 4 bit, little-endian, transfer-property=PENDING
    signal Temp: start 8, 8 bit, little-endian, compu {phys=raw*0.5-40}, transfer-property=PENDING
    signal Flag: start 16, 1 bit, little-endian, transfer-property=PENDING
  pdu Alt1Pdu: length=8
    signal Sel: start 0, 4 bit, little-endian, transfer-property=PENDING
    signal Pressure: start 15, 16 bit, big-endian, compu {phys=raw*0.1}, transfer-property=PENDING
    signal Mode: start 24, 3 bit, little-endian, compu {0=Off, 1=Eco, 2=Normal, 3=Sport}, transfer-property=PENDING
  pdu Alt2Pdu: length=8
    signal Sel: start 0, 4 bit, little-endian, transfer-property=PENDING
    signal Raw: start 8, 32 bit, little-endian, base-type=sint32, transfer-property=PENDING
  pdu Alt5Pdu: length=8
    signal SelB: start 7, 8 bit, big-endian, transfer-property=PENDING
    signal X: start 8, 16 bit, little-endian, transfer-property=PENDING
  pdu Alt10Pdu: length=8
    signal SelB: start 7, 8 bit, big-endian, transfer-property=PENDING
    signal Y: start 23, 12 bit, big-endian, compu {phys=raw*0.1}, transfer-property=PENDING
package /Units
  unit rpm: display-name=rpm
